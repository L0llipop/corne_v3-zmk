#include "corne.dtsi"

&kscan0 {
    col-gpios
        = <&pro_micro 21 GPIO_ACTIVE_HIGH> // Col 0
        , <&pro_micro 20 GPIO_ACTIVE_HIGH> // Col 1
        , <&pro_micro 19 GPIO_ACTIVE_HIGH> // Col 2
        , <&pro_micro 18 GPIO_ACTIVE_HIGH> // Col 3 (R, F, V)
        , <&pro_micro 15 GPIO_ACTIVE_HIGH> // Col 4
        , <&pro_micro 14 GPIO_ACTIVE_HIGH> // Col 5
        ;
};

/ {
    chosen {
        zmk,battery = &vbatt;
    };

    vbatt: vbatt {
        compatible = "zmk,battery-nrf-vddh";
    };
};